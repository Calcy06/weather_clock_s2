## sdkconfig.defaults
```kconfig
# 目标芯片：ESP32-S2-DevKitC-1-N8R2
CONFIG_IDF_TARGET="esp32s2"

# 8MB Flash
CONFIG_ESPTOOLPY_FLASHSIZE_8MB=y
CONFIG_ESPTOOLPY_FLASHSIZE="8MB"

# 自定义分区表
CONFIG_PARTITION_TABLE_CUSTOM=y
CONFIG_PARTITION_TABLE_CUSTOM_FILENAME="partitions.csv"

# 240MHz，字库在 flash 里直接 XIP 读取
CONFIG_ESP_DEFAULT_CPU_FREQ_MHZ_240=y
CONFIG_COMPILER_OPTIMIZATION_PERF=y

# HTTPS 请求心知天气/B站必须带根证书包
CONFIG_MBEDTLS_CERTIFICATE_BUNDLE=y
CONFIG_MBEDTLS_CERTIFICATE_BUNDLE_DEFAULT_FULL=y

# 主任务栈（配网页面拼接 HTML 时用量较大）
CONFIG_ESP_MAIN_TASK_STACK_SIZE=6144

# 喂狗超时放宽：HTTP 请求最长阻塞 8 秒
CONFIG_ESP_TASK_WDT_TIMEOUT_S=20

# 配网热点
CONFIG_ESP_WIFI_SOFTAP_SUPPORT=y

CONFIG_LOG_DEFAULT_LEVEL_INFO=y
```
